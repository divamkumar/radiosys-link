/dts-v1/;
/plugin/;

/ {
    compatible = "brcm,bcm2835";

    fragment@0 {
        target = <&gpio>;
        __overlay__ {
            radiosys_pins: radiosys_pins {
                brcm,pins = <23>;
                brcm,function = <0>; // Input
                brcm,pull = <1>;     // Pull Down
            };
        };
    };

    fragment@1 {
        target-path = "/";
        __overlay__ {
            radiosys_alert_device {
                compatible = "radiosys,mission-alert";
                pinctrl-names = "default";
                pinctrl-0 = <&radiosys_pins>;
                gpios = <&gpio 23 1>; // Rising Edge
            };
        };
    };
};

