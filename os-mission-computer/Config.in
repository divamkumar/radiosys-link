## os-mission-computer/Config.in
```kconfig
source "$BR2_EXTERNAL_RADIOSYS_PATH/package/radiosys-driver/Config.in"
source "$BR2_EXTERNAL_RADIOSYS_PATH/package/radiosys-module/Config.in"
```

## os-mission-computer/configs/radiosys_defconfig
```kconfig
# Architecture
BR2_aarch64=y
BR2_cortex_a72=y

# Linux Kernel
BR2_KERNEL_HEADERS_6_1=y
BR2_LINUX_KERNEL=y
BR2_LINUX_KERNEL_CUSTOM_TARBALL=y
BR2_LINUX_KERNEL_CUSTOM_TARBALL_LOCATION="$(call github,raspberrypi,linux,1.20230405)/linux-1.20230405.tar.gz"
BR2_LINUX_KERNEL_DEFCONFIG="bcm2711"
BR2_LINUX_KERNEL_DTS_SUPPORT=y
BR2_LINUX_KERNEL_INTREE_DTS_NAME="broadcom/bcm2711-rpi-4-b"

# System
BR2_TARGET_GENERIC_HOSTNAME="radiosys-node-a"
BR2_INIT_SYSV=y
BR2_ROOTFS_POST_BUILD_SCRIPT="$(BR2_EXTERNAL_RADIOSYS_PATH)/board/post-build.sh"

# Toolchain
BR2_TOOLCHAIN_BUILDROOT_CXX=y

# Custom Packages (Your Code)
BR2_PACKAGE_RADIOSYS_MODULE=y
BR2_PACKAGE_RADIOSYS_DRIVER=y

# Filesystem Images
BR2_TARGET_ROOTFS_EXT2=y
BR2_TARGET_ROOTFS_EXT2_4=y
```

## os-mission-computer/package/radiosys-driver/Config.in
```kconfig
config BR2_PACKAGE_RADIOSYS_DRIVER
    bool "radiosys-driver"
    depends on BR2_INSTALL_LIBSTDCPP
    help
      User space telemetry daemon.
```

## os-mission-computer/package/radiosys-module/Config.in
```kconfig
config BR2_PACKAGE_RADIOSYS_MODULE
    bool "radiosys-module"
    depends on BR2_LINUX_KERNEL
    help
      Kernel module for RadioSys-Link interrupt handling.
```
